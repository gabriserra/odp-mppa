/* Entry point */
/* Entry point */
ENTRY(_start)

K1_BOOT_ADDRESS = DEFINED(K1_BOOT_ADDRESS) ? K1_BOOT_ADDRESS : 0x0;
K1_EXCEPTION_ADDRESS = DEFINED(K1_EXCEPTION_ADDRESS) ? K1_EXCEPTION_ADDRESS : 0x400;
K1_INTERRUPT_ADDRESS = DEFINED(K1_INTERRUPT_ADDRESS) ? K1_INTERRUPT_ADDRESS : 0x800;
K1_SYSCALL_ADDRESS = DEFINED(K1_SYSCALL_ADDRESS) ? K1_SYSCALL_ADDRESS : 0xc00;

RM_STACK_SIZE = DEFINED(RM_STACK_SIZE) ? RM_STACK_SIZE : 8K;
PAGE_SIZE = 4096;
MPPA_ARGAREA_SIZE = DEFINED(MPPA_ARGAREA_SIZE) ? MPPA_ARGAREA_SIZE : 4K;

INCLUDE memory_map.ld

INTERNAL_RAM_BASE = DEFINED(INTERNAL_RAM_BASE) ? INTERNAL_RAM_BASE : ORIGIN(internal_mem);
INTERNAL_RAM_SIZE = DEFINED(INTERNAL_RAM_SIZE) ? INTERNAL_RAM_SIZE : LENGTH(internal_mem);

DEBUG_SIZE = 32;
DEBUG_BASE = INTERNAL_RAM_BASE + INTERNAL_RAM_SIZE - DEBUG_SIZE;

RamBase = DEFINED(RamBase) ? RamBase : ORIGIN(ddr);
RamSize = DEFINED(RamSize) ? RamSize : LENGTH(ddr);

MPPA_SPAWN_DIRECTORY_SIZE = DEFINED(MPPA_SPAWN_DIRECTORY_SIZE) ? MPPA_SPAWN_DIRECTORY_SIZE : 8K;

MPPA_IMAGES_DIRECTORY_ADDRESS = DEFINED(MPPA_IMAGES_DIRECTORY_ADDRESS) ? MPPA_IMAGES_DIRECTORY_ADDRESS : RamBase;
MPPA_IMAGES_DIRECTORY_SIZE = DEFINED(MPPA_IMAGES_DIRECTORY_SIZE) ? MPPA_IMAGES_DIRECTORY_SIZE : 32M;

